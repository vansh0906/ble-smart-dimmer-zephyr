## CMakeLists.txt
```
cmake_minimum_required(VERSION 3.20.0)
find_package(Zephyr REQUIRED HINTS $ENV{ZEPHYR_BASE})
project(ble_smart_dimmer)

target_sources(app PRIVATE
  src/main.c
  src/ble_svc.c
  src/power_stage_sim.c
  ../lib/dimmer.c
  ../lib/meter.c)
target_include_directories(app PRIVATE ../lib src)
```

## Kconfig
```
config APP_TEST_HOOKS
	bool "Fault-injection GATT characteristic (test builds only)"
	help
	  Adds a characteristic the test central uses to inject overcurrent, a short, overtemperature
	  and mains loss into the simulated power stage, and to read the model's true power.

source "Kconfig.zephyr"
```

## prj.conf
```kconfig
# BLE peripheral
CONFIG_BT=y
CONFIG_BT_PERIPHERAL=y
CONFIG_BT_DEVICE_NAME="VG Dimmer"
CONFIG_BT_MAX_CONN=1
CONFIG_BT_SMP=y
CONFIG_BT_BONDABLE=n
CONFIG_BT_GATT_DYNAMIC_DB=n

# settings in flash (NVS)
CONFIG_FLASH=y
CONFIG_FLASH_MAP=y
CONFIG_FLASH_PAGE_LAYOUT=y
CONFIG_NVS=y
CONFIG_SETTINGS=y
CONFIG_SETTINGS_NVS=y

CONFIG_MAIN_STACK_SIZE=4096
CONFIG_SYSTEM_WORKQUEUE_STACK_SIZE=2048
CONFIG_COMPILER_WARNINGS_AS_ERRORS=y
CONFIG_ASSERT=y
```

## test.conf
```kconfig
CONFIG_APP_TEST_HOOKS=y
```

## src/main.c
```c
/*
 * BLE smart dimmer firmware (Zephyr RTOS).
 *
 * Event-driven: a 10 ms kernel timer releases the control thread (measure, protect, fade, output);
 * BLE writes act on the dimmer directly in the Bluetooth RX context and report errors synchronously;
 * notifications and flash saves run as work items. Settings (last level, on/off, fade time) are kept
 * in flash with the settings subsystem (NVS), so the dimmer comes back the same after a power cut.
 */
#include <string.h>
#include <zephyr/kernel.h>
#include <zephyr/settings/settings.h>
#include <zephyr/sys/printk.h>

#include "app.h"
#include "power_stage.h"

K_MUTEX_DEFINE(app_lock);
dimmer_t dim;
meter_t meter;

static K_SEM_DEFINE(tick_sem, 0, 1);
static uint8_t saved_level = 100, saved_on, restored;
static uint16_t saved_fade = DIM_FADE_DEFAULT_MS;
static struct dim_status last_status;
static uint32_t inject_ms;
static uint8_t inject_kind;

/* ------------------------------------------------------------------ settings */
static int dim_settings_set(const char *key, size_t len, settings_read_cb read_cb, void *cb_arg)
{
    if (!strcmp(key, "lvl") && len == 1) {
        restored = 1;
        return read_cb(cb_arg, &saved_level, 1) == 1 ? 0 : -EINVAL;
    }
    if (!strcmp(key, "on") && len == 1) {
        return read_cb(cb_arg, &saved_on, 1) == 1 ? 0 : -EINVAL;
    }
    if (!strcmp(key, "fade") && len == 2) {
        return read_cb(cb_arg, &saved_fade, 2) == 2 ? 0 : -EINVAL;
    }
    return -ENOENT;
}
SETTINGS_STATIC_HANDLER_DEFINE(dim, "dim", NULL, dim_settings_set, NULL, NULL);

static void save_work_fn(struct k_work *w)
{
    uint8_t lvl, on;
    uint16_t fade;
    ARG_UNUSED(w);
    k_mutex_lock(&app_lock, K_FOREVER);
    lvl = dim.last_on;
    on = dim.state == DIM_ON;
    fade = dim.fade_default_ms;
    k_mutex_unlock(&app_lock);
    if (lvl != saved_level || on != saved_on || fade != saved_fade) {
        settings_save_one("dim/lvl", &lvl, 1);
        settings_save_one("dim/on", &on, 1);
        settings_save_one("dim/fade", &fade, 2);
        saved_level = lvl;
        saved_on = on;
        saved_fade = fade;
        printk("SAVE t=%u lvl=%u on=%u fade=%u\n", k_uptime_get_32(), lvl, on, fade);
    }
}
static K_WORK_DELAYABLE_DEFINE(save_work, save_work_fn);

/* ------------------------------------------------------------------ status */
void app_fill_status(struct dim_status *s)
{
    s->state = (uint8_t)dim.state;
    s->target = dim.target;
    s->level = (uint8_t)(dim.level + 0.5f);
    s->faults = dim.faults;
    s->flags = dim.flags;
    s->temp_c = (int8_t)dim.last_in.temp_c;
    s->fade_ms = dim.fade_default_ms;
}

void app_fill_meter(struct dim_meter *m)
{
    m->power_dw = (uint16_t)(meter.power_w > 0.0f ? meter.power_w * 10.0f + 0.5f : 0.0f);
    m->energy_mwh = (uint32_t)(meter.energy_wh * 1000.0);
    m->vrms_dv = (uint16_t)(meter.vrms * 10.0f + 0.5f);
    m->irms_ma = (uint16_t)(meter.irms * 1000.0f + 0.5f);
    m->pf_pct = (uint8_t)(meter.pf * 100.0f + 0.5f);
}

void app_changed(void)
{
    k_work_reschedule(&save_work, K_MSEC(500));        /* debounce flash writes */
}

/* ------------------------------------------------------------------ test hooks */
void app_inject(uint8_t op, int32_t arg)
{
    uint32_t now = k_uptime_get_32();
    switch (op) {
    case 1: ps_inject_extra_current((float)arg / 10.0f); break;
    case 2: ps_inject_short(arg != 0); break;
    case 3: ps_inject_temperature((float)arg); break;
    case 4: ps_inject_mains_off(now, (uint32_t)arg); break;
    default: ps_clear_injections(); break;
    }
    inject_ms = now;
    inject_kind = op;
    printk("INJECT t=%u op=%u arg=%d\n", now, op, arg);
}

void app_true_meter(uint16_t *power_dw, uint32_t *energy_mwh)
{
    float p = ps_true_power_w();
    *power_dw = (uint16_t)(p > 0.0f ? p * 10.0f + 0.5f : 0.0f);
    *energy_mwh = (uint32_t)(ps_true_energy_wh() * 1000.0);
}

/* ------------------------------------------------------------------ control loop */
static void tick_timer_fn(struct k_timer *t)
{
    ARG_UNUSED(t);
    k_sem_give(&tick_sem);
}
static K_TIMER_DEFINE(tick_timer, tick_timer_fn, NULL);

int main(void)
{
    dim_inputs_t in;
    uint32_t ticks = 0;
    uint8_t prev_faults = 0, prev_flags = 0;

    if (ble_init() != 0) {                    /* Bluetooth first, then settings (Zephyr's required order) */
        printk("BLE init failed\n");
        return 0;
    }
    settings_subsys_init();
    settings_load();
    dim_init(&dim, saved_level, saved_on, saved_fade);
    printk("BOOT restored=%u lvl=%u on=%u fade=%u\n", restored, saved_level, saved_on, saved_fade);
    ps_init();
    ble_advertise();
    k_timer_start(&tick_timer, K_MSEC(DIM_TICK_MS), K_MSEC(DIM_TICK_MS));

    for (;;) {
        k_sem_take(&tick_sem, K_FOREVER);
        uint32_t now = k_uptime_get_32();
        struct dim_status st;

        k_mutex_lock(&app_lock, K_FOREVER);
        ps_tick(now, &in, &meter);
        uint16_t duty = dim_tick(&dim, &in);
        ps_set_duty(duty);
        ticks++;
        if (ticks % 10U == 0U) {
            meter_window(&meter, 0.1f);
        }
        if (dim.faults != prev_faults && dim.faults) {
            printk("TRIP t=%u faults=0x%02x after=%u ms (I=%d mA, T=%d C)\n", now, dim.faults, now - inject_ms,
                   (int)(in.current_a * 1000.0f), (int)in.temp_c);
        }
        if ((dim.flags ^ prev_flags) & DIM_FLAG_MAINS_LOST) {
            printk("MAINS t=%u %s after=%u ms\n", now, (dim.flags & DIM_FLAG_MAINS_LOST) ? "lost" : "back",
                   now - inject_ms);
        }
        prev_faults = dim.faults;
        prev_flags = dim.flags;
        app_fill_status(&st);
        k_mutex_unlock(&app_lock);

        bool changed = memcmp(&st, &last_status, sizeof st) != 0;
        bool fading = st.flags & DIM_FLAG_FADING;
        if (changed && (!fading || ticks % 5U == 0U)) {      /* during a fade: every 50 ms */
            last_status = st;
            ble_notify_status();
        }
        if (ticks % 10U == 0U) {
            printk("LOG t=%u st=%u tgt=%u lvl=%u duty=%u f=0x%02x fl=0x%02x I=%d T=%d P=%d\n", now, st.state,
                   st.target, st.level, duty, st.faults, st.flags, (int)(in.current_a * 1000.0f), (int)in.temp_c,
                   (int)(meter.power_w * 10.0f));
        }
        if (ticks % 100U == 0U) {
            ble_notify_meter();
        }
    }
    return 0;
}
```

## src/app.h
```c
#ifndef APP_H
#define APP_H

#include <stdint.h>
#include <zephyr/kernel.h>
#include "dimmer.h"
#include "meter.h"

/* Shared between the control loop (10 ms timer) and BLE callbacks; guarded by app_lock. */
extern struct k_mutex app_lock;
extern dimmer_t dim;
extern meter_t meter;

struct __packed dim_status {
    uint8_t state;
    uint8_t target;
    uint8_t level;          /* actual perceived level, rounded */
    uint8_t faults;
    uint8_t flags;
    int8_t temp_c;
    uint16_t fade_ms;       /* default fade */
};

struct __packed dim_meter {
    uint16_t power_dw;      /* 0.1 W */
    uint32_t energy_mwh;
    uint16_t vrms_dv;       /* 0.1 V */
    uint16_t irms_ma;
    uint8_t pf_pct;
};

void app_fill_status(struct dim_status *s);
void app_fill_meter(struct dim_meter *m);
void app_changed(void);                       /* status changed: notify + schedule a settings save */
void app_inject(uint8_t op, int32_t arg);     /* test hooks */
void app_true_meter(uint16_t *power_dw, uint32_t *energy_mwh);

/* ble_svc.c */
int ble_init(void);
void ble_advertise(void);
void ble_notify_status(void);
void ble_notify_meter(void);

#endif
```

## src/ble_svc.c
```c
/*
 * BLE peripheral: advertising and the Dimmer GATT service.
 *
 *   Level   (read, write*, notify not used)  uint8 0..100, 0 = off, uses the default fade
 *   Fade    (read, write*)                   uint16 ms, 0..10000
 *   Command (write*)                         1 on, 2 off, 3 toggle, 4 reset fault
 *   Status  (read, notify)                   struct dim_status
 *   Meter   (read, notify every 1 s)         struct dim_meter
 *   Test    (write*, read; test builds only) fault injection, true power from the load model
 *   (* = needs an encrypted link: LE Secure Connections pairing)
 *
 * Writes are validated here and answered with an ATT error the phone can show:
 *   0x13 value not allowed, 0x0D bad length, 0x80 dimmer in fault, 0x81 fault cause still present.
 */
#include <zephyr/bluetooth/bluetooth.h>
#include <zephyr/bluetooth/conn.h>
#include <zephyr/bluetooth/gatt.h>
#include <zephyr/bluetooth/uuid.h>
#include <zephyr/sys/byteorder.h>
#include <zephyr/sys/printk.h>

#include "app.h"

#define DIM_UUID(n) BT_UUID_128_ENCODE(0x6d0c0000 + (n), 0x4c5a, 0x4d1e, 0x9a3b, 0x1f2e3d4c5b6a)
static const struct bt_uuid_128 svc_uuid = BT_UUID_INIT_128(DIM_UUID(1));
static const struct bt_uuid_128 level_uuid = BT_UUID_INIT_128(DIM_UUID(2));
static const struct bt_uuid_128 fade_uuid = BT_UUID_INIT_128(DIM_UUID(3));
static const struct bt_uuid_128 cmd_uuid = BT_UUID_INIT_128(DIM_UUID(4));
static const struct bt_uuid_128 status_uuid = BT_UUID_INIT_128(DIM_UUID(5));
static const struct bt_uuid_128 meter_uuid = BT_UUID_INIT_128(DIM_UUID(6));
#if defined(CONFIG_APP_TEST_HOOKS)
static const struct bt_uuid_128 test_uuid = BT_UUID_INIT_128(DIM_UUID(0xF0));
#endif

#define ERR_FAULT 0x80
#define ERR_CAUSE 0x81

static ssize_t map_err(int r)
{
    switch (r) {
    case DIM_E_RANGE: return BT_GATT_ERR(BT_ATT_ERR_VALUE_NOT_ALLOWED);
    case DIM_E_FAULT: return BT_GATT_ERR(ERR_FAULT);
    case DIM_E_CAUSE: return BT_GATT_ERR(ERR_CAUSE);
    default: return 0;
    }
}

static ssize_t read_level(struct bt_conn *c, const struct bt_gatt_attr *a, void *buf, uint16_t len, uint16_t off)
{
    uint8_t v = dim.target;
    return bt_gatt_attr_read(c, a, buf, len, off, &v, 1);
}

static ssize_t write_level(struct bt_conn *c, const struct bt_gatt_attr *a, const void *buf, uint16_t len,
                           uint16_t off, uint8_t flags)
{
    ARG_UNUSED(c); ARG_UNUSED(a); ARG_UNUSED(flags);
    if (off || len != 1) {
        return BT_GATT_ERR(BT_ATT_ERR_INVALID_ATTRIBUTE_LEN);
    }
    k_mutex_lock(&app_lock, K_FOREVER);
    int r = dim_set_level(&dim, ((const uint8_t *)buf)[0], -1);
    k_mutex_unlock(&app_lock);
    if (r) {
        return map_err(r);
    }
    app_changed();
    return len;
}

static ssize_t read_fade(struct bt_conn *c, const struct bt_gatt_attr *a, void *buf, uint16_t len, uint16_t off)
{
    uint16_t v = sys_cpu_to_le16(dim.fade_default_ms);
    return bt_gatt_attr_read(c, a, buf, len, off, &v, 2);
}

static ssize_t write_fade(struct bt_conn *c, const struct bt_gatt_attr *a, const void *buf, uint16_t len,
                          uint16_t off, uint8_t flags)
{
    ARG_UNUSED(c); ARG_UNUSED(a); ARG_UNUSED(flags);
    if (off || len != 2) {
        return BT_GATT_ERR(BT_ATT_ERR_INVALID_ATTRIBUTE_LEN);
    }
    k_mutex_lock(&app_lock, K_FOREVER);
    int r = dim_set_fade(&dim, sys_get_le16(buf));
    k_mutex_unlock(&app_lock);
    if (r) {
        return map_err(r);
    }
    app_changed();
    return len;
}

static ssize_t write_cmd(struct bt_conn *c, const struct bt_gatt_attr *a, const void *buf, uint16_t len,
                         uint16_t off, uint8_t flags)
{
    ARG_UNUSED(c); ARG_UNUSED(a); ARG_UNUSED(flags);
    if (off || len != 1) {
        return BT_GATT_ERR(BT_ATT_ERR_INVALID_ATTRIBUTE_LEN);
    }
    int r;
    k_mutex_lock(&app_lock, K_FOREVER);
    switch (((const uint8_t *)buf)[0]) {
    case 1: r = dim_on(&dim); break;
    case 2: r = dim_off(&dim); break;
    case 3: r = dim_toggle(&dim); break;
    case 4: r = dim_reset(&dim); break;
    default: r = DIM_E_RANGE; break;
    }
    k_mutex_unlock(&app_lock);
    if (r) {
        return map_err(r);
    }
    app_changed();
    return len;
}

static ssize_t read_status(struct bt_conn *c, const struct bt_gatt_attr *a, void *buf, uint16_t len, uint16_t off)
{
    struct dim_status s;
    k_mutex_lock(&app_lock, K_FOREVER);
    app_fill_status(&s);
    k_mutex_unlock(&app_lock);
    return bt_gatt_attr_read(c, a, buf, len, off, &s, sizeof s);
}

static ssize_t read_meter(struct bt_conn *c, const struct bt_gatt_attr *a, void *buf, uint16_t len, uint16_t off)
{
    struct dim_meter m;
    k_mutex_lock(&app_lock, K_FOREVER);
    app_fill_meter(&m);
    k_mutex_unlock(&app_lock);
    return bt_gatt_attr_read(c, a, buf, len, off, &m, sizeof m);
}

#if defined(CONFIG_APP_TEST_HOOKS)
static ssize_t write_test(struct bt_conn *c, const struct bt_gatt_attr *a, const void *buf, uint16_t len,
                          uint16_t off, uint8_t flags)
{
    ARG_UNUSED(c); ARG_UNUSED(a); ARG_UNUSED(flags);
    if (off || len != 5) {
        return BT_GATT_ERR(BT_ATT_ERR_INVALID_ATTRIBUTE_LEN);
    }
    const uint8_t *b = buf;
    k_mutex_lock(&app_lock, K_FOREVER);
    app_inject(b[0], (int32_t)sys_get_le32(b + 1));
    k_mutex_unlock(&app_lock);
    return len;
}

static ssize_t read_test(struct bt_conn *c, const struct bt_gatt_attr *a, void *buf, uint16_t len, uint16_t off)
{
    uint8_t v[6];
    uint16_t p;
    uint32_t e;
    k_mutex_lock(&app_lock, K_FOREVER);
    app_true_meter(&p, &e);
    k_mutex_unlock(&app_lock);
    sys_put_le16(p, v);
    sys_put_le32(e, v + 2);
    return bt_gatt_attr_read(c, a, buf, len, off, v, sizeof v);
}
#endif

static void ccc_changed(const struct bt_gatt_attr *attr, uint16_t value)
{
    ARG_UNUSED(attr);
    printk("CCC t=%u value=%u\n", k_uptime_get_32(), value);
}

BT_GATT_SERVICE_DEFINE(dim_svc,
    BT_GATT_PRIMARY_SERVICE(&svc_uuid),
    BT_GATT_CHARACTERISTIC(&level_uuid.uuid, BT_GATT_CHRC_READ | BT_GATT_CHRC_WRITE,
                           BT_GATT_PERM_READ | BT_GATT_PERM_WRITE_ENCRYPT, read_level, write_level, NULL),
    BT_GATT_CHARACTERISTIC(&fade_uuid.uuid, BT_GATT_CHRC_READ | BT_GATT_CHRC_WRITE,
                           BT_GATT_PERM_READ | BT_GATT_PERM_WRITE_ENCRYPT, read_fade, write_fade, NULL),
    BT_GATT_CHARACTERISTIC(&cmd_uuid.uuid, BT_GATT_CHRC_WRITE, BT_GATT_PERM_WRITE_ENCRYPT, NULL, write_cmd, NULL),
    BT_GATT_CHARACTERISTIC(&status_uuid.uuid, BT_GATT_CHRC_READ | BT_GATT_CHRC_NOTIFY, BT_GATT_PERM_READ,
                           read_status, NULL, NULL),
    BT_GATT_CCC(ccc_changed, BT_GATT_PERM_READ | BT_GATT_PERM_WRITE),
    BT_GATT_CHARACTERISTIC(&meter_uuid.uuid, BT_GATT_CHRC_READ | BT_GATT_CHRC_NOTIFY, BT_GATT_PERM_READ,
                           read_meter, NULL, NULL),
    BT_GATT_CCC(ccc_changed, BT_GATT_PERM_READ | BT_GATT_PERM_WRITE),
#if defined(CONFIG_APP_TEST_HOOKS)
    BT_GATT_CHARACTERISTIC(&test_uuid.uuid, BT_GATT_CHRC_READ | BT_GATT_CHRC_WRITE,
                           BT_GATT_PERM_READ | BT_GATT_PERM_WRITE_ENCRYPT, read_test, write_test, NULL),
#endif
);

#define ATTR_STATUS (&dim_svc.attrs[8])
#define ATTR_METER (&dim_svc.attrs[11])

void ble_notify_status(void)
{
    struct dim_status s;
    k_mutex_lock(&app_lock, K_FOREVER);
    app_fill_status(&s);
    k_mutex_unlock(&app_lock);
    (void)bt_gatt_notify(NULL, ATTR_STATUS, &s, sizeof s);
}

void ble_notify_meter(void)
{
    struct dim_meter m;
    k_mutex_lock(&app_lock, K_FOREVER);
    app_fill_meter(&m);
    k_mutex_unlock(&app_lock);
    (void)bt_gatt_notify(NULL, ATTR_METER, &m, sizeof m);
}

/* ------------------------------------------------------------------ advertising + connections */
static const struct bt_data ad[] = {
    BT_DATA_BYTES(BT_DATA_FLAGS, (BT_LE_AD_GENERAL | BT_LE_AD_NO_BREDR)),
    BT_DATA_BYTES(BT_DATA_UUID128_ALL, DIM_UUID(1)),
};
static const struct bt_data sd[] = {
    BT_DATA(BT_DATA_NAME_COMPLETE, CONFIG_BT_DEVICE_NAME, sizeof(CONFIG_BT_DEVICE_NAME) - 1),
};

static void adv_work_fn(struct k_work *w)
{
    ARG_UNUSED(w);
    int err = bt_le_adv_start(BT_LE_ADV_CONN_FAST_1, ad, ARRAY_SIZE(ad), sd, ARRAY_SIZE(sd));
    printk("ADV t=%u start err=%d\n", k_uptime_get_32(), err);
}
static K_WORK_DEFINE(adv_work, adv_work_fn);

static void connected(struct bt_conn *conn, uint8_t err)
{
    ARG_UNUSED(conn);
    printk("CONNECTED t=%u err=0x%02x\n", k_uptime_get_32(), err);
}

static void disconnected(struct bt_conn *conn, uint8_t reason)
{
    ARG_UNUSED(conn);
    printk("DISCONNECTED t=%u reason=0x%02x\n", k_uptime_get_32(), reason);
}

static void recycled(void)
{
    k_work_submit(&adv_work);                 /* advertise again so the phone can come back */
}

static void security_changed(struct bt_conn *conn, bt_security_t level, enum bt_security_err err)
{
    ARG_UNUSED(conn);
    printk("SECURITY t=%u level=%d err=%d\n", k_uptime_get_32(), level, err);
}

BT_CONN_CB_DEFINE(conn_cbs) = {
    .connected = connected,
    .disconnected = disconnected,
    .recycled = recycled,
    .security_changed = security_changed,
};

int ble_init(void)
{
    return bt_enable(NULL);
}

void ble_advertise(void)
{
    k_work_submit(&adv_work);
}
```

## src/power_stage.h
```c
/*
 * Power stage interface: what the firmware drives (the output duty) and what it measures.
 *
 * On a real dimmer this would be a phase-cut or PWM driver plus ADC channels for mains voltage,
 * load current and an NTC on the heatsink. Here it is implemented by a model of 120 V / 60 Hz mains,
 * an LED-driver load, a 12-bit ADC and a heatsink (power_stage_sim.c), so the same firmware can be
 * tested on the simulated nRF52.
 */
#ifndef POWER_STAGE_H
#define POWER_STAGE_H

#include <stdbool.h>
#include <stdint.h>
#include "dimmer.h"
#include "meter.h"

void ps_init(void);
void ps_set_duty(uint16_t permille);
/* Advance the hardware by one 10 ms tick: fills the dimmer inputs and feeds ADC samples to the meter. */
void ps_tick(uint32_t now_ms, dim_inputs_t *in, meter_t *m);

/* Test hooks (fault injection), only used by the test build */
void ps_inject_extra_current(float amps);
void ps_inject_short(bool on);
void ps_inject_temperature(float celsius);
void ps_inject_mains_off(uint32_t now_ms, uint32_t ms);
void ps_clear_injections(void);
float ps_true_power_w(void);       /* model's exact power, averaged over the last 100 ms */
double ps_true_energy_wh(void);
float ps_temperature(void);

#endif
```

## src/power_stage_sim.c
```c
/*
 * Power stage model: 120 V RMS / 60 Hz mains, an LED-driver load (4 A RMS at full output, power
 * factor 0.95), a 12-bit ADC sampling at 6 kHz with 0.2 % current-gain error and +/-1 LSB noise,
 * and a first-order heatsink thermal model. Runs inside the firmware image in simulated time.
 */
#include <math.h>
#include "power_stage.h"

#define FS_HZ           6000U
#define SAMPLES_TICK    (FS_HZ * DIM_TICK_MS / 1000U)   /* 60 */
#define CYCLE_SAMPLES   (FS_HZ / 60U)                    /* 100 = one mains cycle */
#define V_RMS           120.0f
#define I_FULL_RMS      4.0f
#define PF              0.95f
#define TWO_PI          6.28318530718f

static uint16_t duty;
static uint64_t n_sample;
static float extra_a, temp_c = 25.0f, ambient_c = 25.0f;
static bool short_on;
static uint32_t mains_off_until;
static float i_ring[CYCLE_SAMPLES];
static uint32_t ring_pos;
static double true_p_acc, true_energy_wh;
static uint32_t true_p_n;
static float true_p_last;
static uint32_t lcg = 12345;

static float noise_lsb(void)
{
    lcg = lcg * 1103515245U + 12345U;
    return (float)((int)((lcg >> 16) % 3U) - 1);        /* -1, 0 or +1 LSB */
}

void ps_init(void) { duty = 0; }
void ps_set_duty(uint16_t permille) { duty = permille > 1000U ? 1000U : permille; }

void ps_tick(uint32_t now_ms, dim_inputs_t *in, meter_t *m)
{
    const float phi = acosf(PF);
    const float w = TWO_PI * 60.0f / FS_HZ;
    bool mains = now_ms >= mains_off_until;
    /* load and fault currents only flow while the output conducts */
    float conduct = (float)duty / 1000.0f;
    float i_rms_load = (short_on && duty) ? 20.0f : I_FULL_RMS * conduct;
    float extra = extra_a * conduct;
    float prev_v = 0.0f;
    bool zc = false;
    double p_tick = 0.0;
    float peak = 0.0f;

    for (uint32_t k = 0; k < SAMPLES_TICK; k++, n_sample++) {
        float th = w * (float)(n_sample % CYCLE_SAMPLES);
        float v = mains ? V_RMS * 1.41421356f * sinf(th) : 0.0f;
        float i = mains ? 1.41421356f * (i_rms_load * sinf(th - phi) + extra * sinf(th)) : 0.0f;
        if (k && ((prev_v < 0.0f && v >= 0.0f) || (prev_v > 0.0f && v <= 0.0f)) && mains) {
            zc = true;
        }
        prev_v = v;
        p_tick += (double)v * (double)i;
        /* what the ADC sees */
        int16_t cv = meter_adc_v(v), ci = meter_adc_i(i * 1.002f);
        float mv = meter_counts_to_v((int16_t)(cv + noise_lsb()));
        float mi = meter_counts_to_i((int16_t)(ci + noise_lsb()));
        meter_add(m, mv, mi);
        i_ring[ring_pos] = mi;
        peak = fabsf(mi) > peak ? fabsf(mi) : peak;
        ring_pos = (ring_pos + 1U) % CYCLE_SAMPLES;
    }
    p_tick /= SAMPLES_TICK;
    true_p_acc += p_tick;
    true_p_n++;
    true_energy_wh += p_tick > 0.0 ? p_tick * DIM_TICK_MS / 3.6e6 : 0.0;
    if (true_p_n == 10U) {
        true_p_last = (float)(true_p_acc / true_p_n);
        true_p_acc = 0.0;
        true_p_n = 0;
    }

    /* heatsink: +20 C over ambient at full load, 20 s time constant */
    float p = p_tick > 0.0 ? (float)p_tick : 0.0f;
    float t_target = ambient_c + p * (20.0f / (V_RMS * I_FULL_RMS * PF));
    temp_c += (t_target - temp_c) * ((float)DIM_TICK_MS / 20000.0f);

    double s = 0.0;                                       /* RMS current over the last mains cycle */
    for (uint32_t k = 0; k < CYCLE_SAMPLES; k++) {
        s += (double)i_ring[k] * (double)i_ring[k];
    }
    in->current_a = (float)sqrt(s / CYCLE_SAMPLES);
    in->peak_a = peak;
    in->temp_c = temp_c;
    in->zero_cross = zc;
}

void ps_inject_extra_current(float amps) { extra_a = amps; }
void ps_inject_short(bool on) { short_on = on; }
void ps_inject_temperature(float c) { temp_c = c; ambient_c = c; }
void ps_inject_mains_off(uint32_t now_ms, uint32_t ms) { mains_off_until = now_ms + ms; }
void ps_clear_injections(void)
{
    extra_a = 0.0f;
    short_on = false;
    ambient_c = 25.0f;
    temp_c = 25.0f;
    mains_off_until = 0;
}
float ps_true_power_w(void) { return true_p_last; }
double ps_true_energy_wh(void) { return true_energy_wh; }
float ps_temperature(void) { return temp_c; }
```
